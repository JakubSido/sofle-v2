## Kconfig
```kconfig
# Copyright (c) 2024 The ZMK Contributors
# SPDX-License-Identifier: MIT

config NICE_VIEW_VCOM_KEEPALIVE
    bool "Periodically refresh the nice!view to keep its VCOM toggling"
    depends on ZMK_DISPLAY
    help
      Forces a full-screen redraw of the nice!view display on a fixed interval.
      Sharp memory-in-pixel (MIP) panels need VCOM toggled regularly or the
      image decays into garbage; the ls0xx driver only toggles VCOM when ZMK
      sends a frame. On a split peripheral the widget rarely updates, so this
      keeps the panel refreshed. Enabled automatically by the nice_view_mip
      shield.

config NICE_VIEW_VCOM_KEEPALIVE_INTERVAL_MS
    int "nice!view VCOM keepalive interval (ms)"
    depends on NICE_VIEW_VCOM_KEEPALIVE
    default 1000
    help
      How often to force a full-screen redraw. Lower is safer for the panel but
      costs a little more power. Raise it if the image stays clean at a larger
      value.

config DEDA_DISPLAY
    bool "Custom nice!view peripheral status screen with a custom image"
    depends on ZMK_DISPLAY
    select LV_USE_IMG
    select LV_USE_CANVAS
    select LV_FONT_MONTSERRAT_16
    help
      Provides our own zmk_display_status_screen() (src/deda_display/) that shows
      a custom 140x68 art image plus the battery and connection status, instead
      of nice_view's built-in balloon/mountain widget. Set
      CONFIG_NICE_VIEW_WIDGET_STATUS=n alongside this so nice_view does not also
      compile its own status screen (which would clash).
```

## boards/shields/sofle_peripheral_left/Kconfig.defconfig
```kconfig
if SHIELD_SOFLE_PERIPHERAL_LEFT

config ZMK_SPLIT_ROLE_CENTRAL
    default n

endif # SHIELD_SOFLE_PERIPHERAL_LEFT
```

## boards/shields/sofle_peripheral_left/Kconfig.shield
```kconfig
config SHIELD_SOFLE_PERIPHERAL_LEFT
    def_bool $(shields_list_contains,sofle_peripheral_left)
    select SHIELD_SOFLE_LEFT
```

## boards/shields/sofle_peripheral_right/Kconfig.defconfig
```kconfig
if SHIELD_SOFLE_PERIPHERAL_RIGHT

config ZMK_SPLIT_ROLE_CENTRAL
    default n

endif # SHIELD_SOFLE_PERIPHERAL_RIGHT
```

## boards/shields/sofle_peripheral_right/Kconfig.shield
```kconfig
config SHIELD_SOFLE_PERIPHERAL_RIGHT
    def_bool $(shields_list_contains,sofle_peripheral_right)
    select SHIELD_SOFLE_RIGHT
```
